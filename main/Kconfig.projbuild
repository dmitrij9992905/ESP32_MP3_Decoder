## main/Kconfig.projbuild
```kconfig
menu "Web Radio / Bluetooth Speaker"

menu "Wifi Configuration"

config WIFI_SSID
    string "WiFi SSID"
	default "myssid"
	help
		SSID (network name) to connect to.

config WIFI_PASSWORD
    string "WiFi Password"
	default "myssid"
	help
		WiFi password (WPA or WPA2) to use.

		Can be left blank if the network has no security set.

endmenu

menu "Audio Output"

choice
    prompt "Select Audio Output Mode"
    default I2S
    help
        This option selects the audio output.

    config AUDIO_OUTPUT_MODE_I2S
        bool "Generic I2S"
    config AUDIO_OUTPUT_MODE_I2S_MERUS
        bool "Merus Audio I2S"
    config AUDIO_OUTPUT_MODE_DAC_BUILT_IN
        bool "Built-In DAC"
    config AUDIO_OUTPUT_MODE_PDM
        bool "PDM"
endchoice

config AUDIO_OUTPUT_MODE
    int
    default 0 if AUDIO_OUTPUT_MODE_I2S
    default 1 if AUDIO_OUTPUT_MODE_I2S_MERUS
    default 2 if AUDIO_OUTPUT_MODE_DAC_BUILT_IN
    default 3 if AUDIO_OUTPUT_MODE_PDM

config I2S_DATA_PIN
	int "I2S Data Pin"
	default 22
	help
		Input data pin number
	depends on AUDIO_OUTPUT_MODE_I2S || AUDIO_OUTPUT_MODE_I2S_MERUS

config I2S_BCK_PIN
	int "I2S BCLK Pin"
	default 26
	help
		Input BCLK pin number
	depends on AUDIO_OUTPUT_MODE_I2S || AUDIO_OUTPUT_MODE_I2S_MERUS

config I2S_LRCK_PIN
	int "I2S LRCK Pin"
	default 25
	help
		Input LRCK pin number
	depends on AUDIO_OUTPUT_MODE_I2S || AUDIO_OUTPUT_MODE_I2S_MERUS

endmenu

menuconfig BT_SPEAKER_MODE
    bool "Bluetooth Speaker Mode"
    help
       Select this option to turn on bluetooth speaker mode.
       Web radio streaming will be unavailable.
   depends on CLASSIC_BT_ENABLED && A2DP_ENABLE

config BT_NAME
    string "Bluetooth Name"
	default "ESP_SPEAKER"
	help
		Bluetooth name exposed by the device.
   depends on BT_SPEAKER_MODE

endmenu

menu "I2C config"
config I2C_NUM
	int "I2C Number in ESP32"
	default 0

config I2C_SCL
	int "I2C SCL Pin"
	default 15

config I2C_SDA
	int "I2C SDA Pin"
	default 4

config I2C_FREQ
	int "I2C Frequency"
	default 100000

endmenu

menu "RDA5807 FM Radio"
menuconfig RDA5807_FM_RADIO
	bool "RDA5807 FM Radio"
	help 
		Check whether RDA5807 will be used
endmenu
```
